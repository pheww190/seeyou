## main/Kconfig.projbuild
```kconfig
menu "CSI radio head"

    config CSI_ASSOCIATE
        bool "Associate to an AP (default: off = listen-only)"
        default n
        help
            OFF (the default) is listen-only: no credentials, no association.
            The radio parks on a channel — or hops across several — and captures
            ambient frames from whatever is transmitting around it. Every nearby
            AP beacons several times a second, and those beacons are the signals
            we sense. You do not connect to them; you just listen.

            ON makes the ESP32 join a 2.4 GHz AP. That guarantees a steady
            stream (beacons + your own traffic) and sets the channel for you, but
            it is a convenience, not a requirement.

    if CSI_ASSOCIATE

    config CSI_WIFI_SSID
        string "Wi-Fi SSID (2.4 GHz only)"
        default "YOUR_WIFI_NAME"

    config CSI_WIFI_PASSWORD
        string "Wi-Fi password"
        default "YOUR_WIFI_PASSWORD"

    endif

    if !CSI_ASSOCIATE

    config CSI_HOP
        bool "Hop across channels (hear every nearby transmitter)"
        default y
        help
            CSI is channel-locked, so to use ALL available signals the radio
            cycles through the channels below, capturing whatever frames appear
            on each. Turn this off to sit on one fixed channel instead.

    config CSI_HOP_CHANNELS
        string "Channels to hop (comma list or range, e.g. 1,6,11 or 1-13)"
        depends on CSI_HOP
        default "1,6,11"

    config CSI_HOP_DWELL_MS
        int "Dwell per channel (ms)"
        depends on CSI_HOP
        default 250

    config CSI_LISTEN_CHANNEL
        int "Fixed listen channel (when hopping is off)"
        depends on !CSI_HOP
        range 1 13
        default 6

    endif

    config CSI_NODE_ID
        int "Node ID (unique per board)"
        range 0 255
        default 1
        help
            Stamped into every frame. Give each board a distinct id so a
            multi-node array can be told apart on the host side.

    config CSI_TRAFFIC_GEN
        bool "Generate UDP traffic to keep CSI flowing"
        depends on CSI_ASSOCIATE
        default y
        help
            Sends a UDP datagram to the gateway every 10 ms so the AP replies
            and there is a steady stream of frames to extract CSI from.
            Needs an IP, so it is only available when associated.

    config CSI_ENABLE_SCAN
        bool "Emit periodic AP-scan frames"
        default y
        help
            A scan briefly leaves promiscuous mode, so keep the period large.

    config CSI_SCAN_PERIOD_MS
        int "Scan period (ms)"
        depends on CSI_ENABLE_SCAN
        default 30000

endmenu
```
